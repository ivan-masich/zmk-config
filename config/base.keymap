#include <behaviors.dtsi>
#include <behaviors/num_word.dtsi> // Requires auto-layer module.
#include <dt-bindings/zmk/keys.h>
#ifdef CONFIG_WIRELESS
  #include <dt-bindings/zmk/bt.h>
  #include <dt-bindings/zmk/outputs.h>
  #define _BT_SEL_KEYS_                                                        \
      &bt BT_SEL 0 &bt BT_SEL 1 &bt BT_SEL 2 &bt BT_SEL 3 &bt BT_CLR
#else
  #define _BT_SEL_KEYS_ &trans &trans &trans &trans &trans
#endif
#include <behaviors/rgbled_widget.dtsi>

#include "zmk-helpers/helper.h"
#include "zmk-helpers/unicode-chars/russian.dtsi"
#include "zmk-helpers/unicode-chars/ukrainian.dtsi"
#include "zmk-helpers/unicode-chars/spanish.dtsi"

#define DEF 0
#define CYR 1
#define CYR_EXTRA 2
#define NAV 3
#define FN 4
#define NUM 5
#define SYS 6
#define MOUSE 7

#define XXX &none
#define ___ &trans

/* Global defaults */

#define QUICK_TAP_MS 175

&sk {
  release-after-ms = <900>;
  quick-release;
};

&sl { // Allow sticky mods to chord across sticky layers.
  ignore-modifiers;
};

&lt {
  flavor = "balanced";
  tapping-term-ms = <200>;
  quick-tap-ms = <QUICK_TAP_MS>;
};

/* Homerow mods */

#define KEYS_L LT0 LT1 LT2 LT3 LT4 LM0 LM1 LM2 LM3 LM4 LB0 LB1 LB2 LB3 LB4
#define KEYS_R RT0 RT1 RT2 RT3 RT4 RM0 RM1 RM2 RM3 RM4 RB0 RB1 RB2 RB3 RB4
#ifndef LH2
  #define THUMBS LH1 LH0 RH0 RH1         // Thumbs on 34 keys.
#else
  #define THUMBS LH2 LH1 LH0 RH0 RH1 RH2 // Thumbs on 36+ keys.
#endif

#define MAKE_HRM(NAME, HOLD, TAP, TRIGGER_POS)                                 \
  ZMK_HOLD_TAP(NAME, bindings = <HOLD>, <TAP>; flavor = "balanced";            \
               tapping-term-ms = <280>; quick-tap-ms = <QUICK_TAP_MS>;         \
               require-prior-idle-ms = <150>; hold-trigger-on-release;         \
               hold-trigger-key-positions = <TRIGGER_POS>;)

MAKE_HRM(hml, &kp, &kp, KEYS_R THUMBS) // Left-hand HRMs.
MAKE_HRM(hmr, &kp, &kp, KEYS_L THUMBS) // Right-hand HRMs.

/* Homerow definitions for unicode characters */
MAKE_HRM(hml_ru_f, &kp, &ru_f, KEYS_R THUMBS)
#define LSHFT_RU_F &hml_ru_f LSHFT 0

MAKE_HRM(hml_ru_p, &mo, &ru_p, KEYS_R THUMBS)
#define EXT_RU_P &hml_ru_p CYR_EXTRA 0

MAKE_HRM(hmr_ru_zh, &kp, &ru_zh, KEYS_L THUMBS)
#define RSHFT_RU_ZH &hmr_ru_zh RSHFT 0

MAKE_HRM(hmr_ru_r, &mo, &ru_r, KEYS_L THUMBS)
#define EXT_RU_R &hmr_ru_r CYR_EXTRA 0

/* Double-tap for switching layout   */
ZMK_TAP_DANCE(v_cyr, bindings = <&kp V>, <&to CYR>;
              tapping-term-ms = <200>;)
ZMK_TAP_DANCE(ru_ye_def, bindings = <&ru_ye>, <&to DEF>;
              tapping-term-ms = <200>;)

// Hack: Make HRM combos tap-only (cf, ZMK issue #544).
#define ZMK_COMBO_8(NAME, TAP, POS, LAYERS, COMBO_MS, IDLE_MS, HOLD, SIDE)     \
  MAKE_HRM(hm_combo_##NAME, &kp, TAP, SIDE THUMBS)                             \
  ZMK_COMBO_6(NAME, &hm_combo_##NAME HOLD 0, POS, LAYERS, COMBO_MS, IDLE_MS)

/* Combos, leader key sequences, mouse emulation */

#include "combos.dtsi" // Must be sourced after HRM-combo hack.
#include "leader.dtsi"
#include "mouse.dtsi"

/* Nav cluster */

// Trigger tap-action on all interrupts.
#define MT_CORE                                                                \
  flavor = "tap-preferred";                                                    \
  tapping-term-ms = <220>;                                                     \
  quick-tap-ms = <220>;                                                        \
  hold-trigger-key-positions = <0>;

&mt { MT_CORE };

ZMK_HOLD_TAP(mt_home, bindings = <&masked_home>, <&kp>; MT_CORE)
ZMK_HOLD_TAP(mt_end, bindings = <&masked_end>, <&kp>; MT_CORE)

#define NAV_LEFT  &mt_home 0   LEFT  // Tap: left  | Long-tap: start of line.
#define NAV_RIGHT &mt_end 0    RIGHT // Tap: right | Long-tap: end   of line.
#define NAV_UP    &mt LC(HOME) UP    // Tap: up    | Long-tap: start of doc.
#define NAV_DOWN  &mt LC(END)  DOWN  // Tap: down  | Long-tap: end   of doc.
#define NAV_BSPC  &mt LC(BSPC) BSPC  // Tap: bspc  | Long-tap: delete word bwd.
#define NAV_DEL   &mt LC(DEL)  DEL   // Tap: del   | Long-tap: delete word fwd.

// Mask CTRL on left/right hold to avoid accidental jumps to start/end of doc.
#define MASK_MODS(NAME, MODS, BINDING)                                         \
  ZMK_MOD_MORPH(NAME, bindings = <BINDING>, <BINDING>; mods = <MODS>;)

MASK_MODS(masked_home, (MOD_LCTL), &kp HOME)
MASK_MODS(masked_end,  (MOD_LCTL), &kp END)

/* Magic-shift & auto-layers */

// Tap: repeat after alpha, else sticky-shift |
// Shift + tap/ double-tap: caps-word | Hold: shift.
#define MAGIC_SHIFT &magic_shift LSHFT 0
ZMK_HOLD_TAP(magic_shift, bindings = <&kp>, <&magic_shift_tap>;
             flavor = "balanced"; tapping-term-ms = <200>;
             quick-tap-ms = <QUICK_TAP_MS>;)
ZMK_MOD_MORPH(magic_shift_tap, bindings = <&shift_repeat>, <&caps_word>;
              mods = <(MOD_LSFT)>;)
ZMK_ADAPTIVE_KEY(
    shift_repeat, bindings = <&sk LSHFT>;
    repeat {
      trigger-keys = <A B C D E F G H I J K L M N O P Q R S T U V W X Y Z>;
      bindings = <&key_repeat>;
      max-prior-idle-ms = <1200>;
      strict-modifiers;
    };)
&caps_word { // Mods deactivate caps-word, requires PR #1451. [TODO: rebase]
  /delete-property/ ignore-modifiers;
};

// Tap: num-word | double-tap: sticky num-layer | Hold: num-layer.
#define SMART_NUM &smart_num NUM 0
ZMK_HOLD_TAP(smart_num, bindings = <&mo>, <&num_dance>; flavor = "balanced";
             tapping-term-ms = <200>; quick-tap-ms = <QUICK_TAP_MS>;)
ZMK_TAP_DANCE(num_dance, bindings = <&num_word NUM>, <&sl NUM>;
              tapping-term-ms = <200>;)

// Smart-mouse, requires tri-state module.
ZMK_TRI_STATE(
    smart_mouse, bindings = <&tog MOUSE>, <&none>, <&tog MOUSE>;
    ignored-key-positions =
        <LT1 LT2 LH0 LH1 RT1 RT2 RT3 RM0 RM1 RM2 RM3 RM4 RB1 RB2 RB3 RH0 RH1>;
    ignored-layers = <MOUSE NAV FN>;)

/* Custom behaviors */

// Alt+Tab swapper, requires tri-state module.
ZMK_TRI_STATE(swapper, bindings = <&kt LCMD>, <&kp TAB>, <&kt LCMD>;
              ignored-key-positions = <LT2 RT2 RM1 RM2 RM3>;)

// Define mod-morph with a *single* mod trigger for less repetition.
#define SIMPLE_MORPH(NAME, MOD, BINDING1, BINDING2)                            \
  ZMK_MOD_MORPH(NAME, mods = <(MOD_L##MOD | MOD_R##MOD)>;                      \
                bindings = <BINDING1>, <BINDING2>;)

// Tap: comma | Shift + tap: semicolon | Ctrl + shift + tap: <.
SIMPLE_MORPH(comma_morph, SFT, &kp COMMA, &comma_inner_morph)
SIMPLE_MORPH(comma_inner_morph, CTL, &kp SEMICOLON, &kp LESS_THAN)

// Tap: dot | Shift + tap: colon | Ctrl + shift + tap: >.
SIMPLE_MORPH(dot_morph, SFT, &kp DOT, &dot_inner_morph)
SIMPLE_MORPH(dot_inner_morph, CTL, &kp COLON, &kp GREATER_THAN)

// Tap: qmark | Shift + tap: excl.
SIMPLE_MORPH(qexcl, SFT, &kp QMARK, &kp EXCL)

// Tap: left/right parenthesis | Shft + tap: less-than/greater-than.
SIMPLE_MORPH(lpar_lt, SFT, &kp LPAR, &kp LT)
SIMPLE_MORPH(rpar_gt, SFT, &kp RPAR, &kp GT)

// Tap: space | Shift + tap: dot -> space -> sticky shift | Hold: nav layer.
ZMK_HOLD_TAP(lt_spc, bindings = <&mo>, <&spc_morph>; flavor = "balanced";
             tapping-term-ms = <200>; quick-tap-ms = <QUICK_TAP_MS>;)
SIMPLE_MORPH(spc_morph, SFT, &kp SPACE, &dot_spc)
ZMK_MACRO(dot_spc, bindings = <&kp DOT &kp SPACE &sk LSHFT>; wait-ms = <0>;
          tap-ms = <5>;)

// Tap: backspace | Lshft + tap: delete | Rshft + tap: shift-delete.
ZMK_MOD_MORPH(bs_del, bindings = <&kp BSPC>, <&kp DEL>;
              mods = <(MOD_LSFT|MOD_RSFT)>; keep-mods = <MOD_RSFT>;)

// Tap: copy | double-tap: cut.
ZMK_TAP_DANCE(copy_cut, bindings = <&kp LC(INS)>, <&kp LC(X)>;
              tapping-term-ms = <200>;)

// Sticky shift + leader.
ZMK_MACRO(leader_sft, bindings = <&sk LSHFT &leader>;)

// Aliases.
#define CANCEL      &kp K_CANCEL            // Cancel caps-word & auto-layers.
#define VOL_DOWN    &hmr RALT C_VOL_DN
#define MEDIA_PREV  &hmr RCMD C_PREVIOUS
#define MEDIA_NEXT  &hmr RCTRL C_NEXT
#define TERMINAL    &kp LG(LA(LC(GRAVE)))

/* Keymap */

ZMK_CONDITIONAL_LAYER(sys, FN NUM, SYS) // FN + NUM --> SYS.

#ifndef ZMK_BASE_LAYER
  #define ZMK_BASE_LAYER(name, LT, RT, LM, RM, LB, RB, LH, RH)                 \
      ZMK_LAYER(name, LT RT LM RM LB RB LH RH)
#endif

ZMK_BASE_LAYER(Base,
//╭─────────────┬─────────────┬─────────────┬─────────────┬─────────────╮                             ╭─────────────┬─────────────┬─────────────┬─────────────┬─────────────╮
    &kp B         &kp L         &kp D         &kp C         &v_cyr      ,                               &kp J         &kp Y         &kp O         &kp U         &kp SQT     ,
//├─────────────┼─────────────┼─────────────┼─────────────┼─────────────┤                             ├─────────────┼─────────────┼─────────────┼─────────────┼─────────────┤
    &hml LSHFT N  &hml LCTRL R  &hml LALT T   &hml LCMD  S  &kp G       ,                               &kp P         &hmr RCMD H   &hmr RALT A   &hmr RCTRL E &hmr RSHFT I ,
//├─────────────┼─────────────┼─────────────┼─────────────┼─────────────┤                             ├─────────────┼─────────────┼─────────────┼─────────────┼─────────────┤
    &kp X         &kp Q         &kp M         &kp W         &kp Z       ,                               &kp K         &kp F         &comma_morph  &dot_morph    &qexcl      ,
//╰─────────────┴─────────────┴─────────────┴─────────────┼─────────────┤─────────────╮ ╭─────────────┼─────────────┼─────────────┴─────────────┴───────────────────────────╯
                                                            &lt_spc NAV 0 &lt FN RET  ,   SMART_NUM     MAGIC_SHIFT
//                                                        ╰─────────────┴─────────────╯ ╰─────────────┴─────────────╯
)

ZMK_BASE_LAYER(Cyr,
//╭─────────────┬─────────────┬─────────────┬─────────────┬─────────────╮                             ╭─────────────┬─────────────┬─────────────┬─────────────┬─────────────╮
    &ru_y         &ru_ts        &ru_u         &ru_k         &ru_ye_def  ,                               &ru_n         &ru_g         &ru_sh        &ru_z         &ru_kh      ,
//├─────────────┼─────────────┼─────────────┼─────────────┼─────────────┤                             ├─────────────┼─────────────┼─────────────┼─────────────┼─────────────┤
    LSHFT_RU_F    &ru_bi        &ru_v         &ru_a         EXT_RU_P    ,                               EXT_RU_R      &ru_o         &ru_l         &ru_d         RSHFT_RU_ZH ,
//├─────────────┼─────────────┼─────────────┼─────────────┼─────────────┤                             ├─────────────┼─────────────┼─────────────┼─────────────┼─────────────┤
    &ru_ya        &ru_ch        &ru_s         &ru_m         &ru_i       ,                               &ru_t         &ru_soft      &ru_b         &ru_yu        &ru_e       ,
//╰─────────────┴─────────────┴─────────────┴─────────────┼─────────────┤─────────────╮ ╭─────────────┼─────────────┼─────────────┴─────────────┴───────────────────────────╯
                                                            ___           ___         ,   ___           ___
//                                                        ╰─────────────┴─────────────╯ ╰─────────────┴─────────────╯
)

ZMK_BASE_LAYER(CyrExtra,
//╭─────────────┬─────────────┬─────────────┬─────────────┬─────────────╮                             ╭─────────────┬─────────────┬─────────────┬─────────────┬─────────────╮
    &ru_yo        ___           ___           ___           &uk_ie      ,                               ___           &uk_g         &ru_shch      ___           &kp SQT     ,
//├─────────────┼─────────────┼─────────────┼─────────────┼─────────────┤                             ├─────────────┼─────────────┼─────────────┼─────────────┼─────────────┤
    ___           &uk_yi        ___           ___           ___         ,                               ___           ___           ___           ___           ___         ,
//├─────────────┼─────────────┼─────────────┼─────────────┼─────────────┤                             ├─────────────┼─────────────┼─────────────┼─────────────┼─────────────┤
    ___           ___           ___           ___           &uk_i       ,                               ___           &ru_hard      &comma_morph  &dot_morph    &qexcl      ,
//╰─────────────┴─────────────┴─────────────┴─────────────┼─────────────┤─────────────╮ ╭─────────────┼─────────────┼─────────────┴─────────────┴───────────────────────────╯
                                                            ___           ___         ,   ___           ___
//                                                        ╰─────────────┴─────────────╯ ╰─────────────┴─────────────╯
)

ZMK_BASE_LAYER(Nav,
//╭─────────────┬─────────────┬─────────────┬─────────────┬─────────────╮                             ╭─────────────┬─────────────┬─────────────┬─────────────┬─────────────╮
    &kp ESC       &kp LG(Q)     &kp LG(W)     &swapper      TERMINAL    ,                               &kp PG_UP     NAV_BSPC      NAV_UP        NAV_DEL       ___         ,
//├─────────────┼─────────────┼─────────────┼─────────────┼─────────────┤                             ├─────────────┼─────────────┼─────────────┼─────────────┼─────────────┤
    &sk LSHFT     &sk LCTRL     &sk LALT      &sk LCMD    &kp LG(SPACE) ,                               &kp PG_DN     NAV_LEFT      NAV_DOWN      NAV_RIGHT     &kp RET     ,
//├─────────────┼─────────────┼─────────────┼─────────────┼─────────────┤                             ├─────────────┼─────────────┼─────────────┼─────────────┼─────────────┤
    &kp LG(LS(N5)) ___          ___           ___           ___         ,                               &kp INS       &kp TAB       ___           ___           ___         ,
//╰─────────────┴─────────────┴─────────────┴─────────────┼─────────────┤─────────────╮ ╭─────────────┼─────────────┼─────────────┴─────────────┴───────────────────────────╯
                                                            ___           ___         ,   ___           ___
//                                                        ╰─────────────┴─────────────╯ ╰─────────────┴─────────────╯
)

ZMK_BASE_LAYER(Fn,
//╭─────────────┬─────────────┬─────────────┬─────────────┬─────────────╮                             ╭─────────────┬─────────────┬─────────────┬─────────────┬─────────────╮
    &kp F12       &kp F7        &kp F8        &kp F9        ___         ,                               ___           &kp C_PP      &kp C_VOL_UP  &kp C_MUTE    ___         ,
//├─────────────┼─────────────┼─────────────┼─────────────┼─────────────┤                             ├─────────────┼─────────────┼─────────────┼─────────────┼─────────────┤
    &hml LSHFT F11 &hml LCTRL F4  &hml LALT F5 &hml LCMD F6 ___         ,                               ___           MEDIA_PREV    VOL_DOWN      MEDIA_NEXT    ___         ,
//├─────────────┼─────────────┼─────────────┼─────────────┼─────────────┤                             ├─────────────┼─────────────┼─────────────┼─────────────┼─────────────┤
    &kp F10       &kp F1        &kp F2        &kp F3        ___         ,                               ___           &kp C_BRI_DN  ___           &kp C_BRI_UP  ___         ,
//╰─────────────┴─────────────┴─────────────┴─────────────┼─────────────┤─────────────╮ ╭─────────────┼─────────────┼─────────────┴─────────────┴───────────────────────────╯
                                                            ___           ___         ,   ___           ___
//                                                        ╰─────────────┴─────────────╯ ╰─────────────┴─────────────╯
)

ZMK_BASE_LAYER(Num,
//╭─────────────┬─────────────┬─────────────┬─────────────┬─────────────╮                             ╭─────────────┬─────────────┬─────────────┬─────────────┬─────────────╮
    ___           &kp N7        &kp N8        &kp N9        ___         ,                               ___           ___           ___           ___           ___         ,
//├─────────────┼─────────────┼─────────────┼─────────────┼─────────────┤                             ├─────────────┼─────────────┼─────────────┼─────────────┼─────────────┤
    &hml LSHFT N0  &hml LCTRL N4  &hml LALT N5 &hml LCMD N6 ___         ,                               ___           ___           ___           ___           ___         ,
//├─────────────┼─────────────┼─────────────┼─────────────┼─────────────┤                             ├─────────────┼─────────────┼─────────────┼─────────────┼─────────────┤
    ___           &kp N1        &kp N2        &kp N3        ___         ,                               ___           ___           ___           ___           ___         ,
//╰─────────────┴─────────────┴─────────────┴─────────────┼─────────────┤─────────────╮ ╭─────────────┼─────────────┼─────────────┴─────────────┴───────────────────────────╯
                                                            ___           ___         ,   ___           ___
//                                                        ╰─────────────┴─────────────╯ ╰─────────────┴─────────────╯
)

ZMK_BASE_LAYER(Sys,
//╭─────────────┬─────────────┬─────────────┬─────────────┬─────────────╮                             ╭─────────────┬─────────────┬─────────────┬─────────────┬─────────────╮
                               _BT_SEL_KEYS_                            ,                               ___           ___           ___           ___           &soft_off   ,
//├─────────────┼─────────────┼─────────────┼─────────────┼─────────────┤                             ├─────────────┼─────────────┼─────────────┼─────────────┼─────────────┤
    ___           ___           ___           &ind_bat      &bootloader ,                               &bootloader   &ind_bat      ___           ___           ___         ,
//├─────────────┼─────────────┼─────────────┼─────────────┼─────────────┤                             ├─────────────┼─────────────┼─────────────┼─────────────┼─────────────┤
    ___           ___           ___           ___           &sys_reset  ,                               &sys_reset    ___           ___           ___           ___         ,
//╰─────────────┴─────────────┴─────────────┴─────────────┼─────────────┤─────────────╮ ╭─────────────┼─────────────┼─────────────┴─────────────┴───────────────────────────╯
                                                            ___           ___         ,   ___           ___
//                                                        ╰─────────────┴─────────────╯ ╰─────────────┴─────────────╯
)

ZMK_BASE_LAYER(Mouse,
//╭─────────────┬─────────────┬─────────────┬─────────────┬─────────────╮                             ╭─────────────┬─────────────┬─────────────┬─────────────┬─────────────╮
    ___           ___           ___           ___           ___         ,                               ___           &kp PG_UP     U_MS_U         &kp PG_DN    ___         ,
//├─────────────┼─────────────┼─────────────┼─────────────┼─────────────┤                             ├─────────────┼─────────────┼─────────────┼─────────────┼─────────────┤
    ___           ___           ___           ___           ___         ,                               U_WH_L        U_MS_L        U_MS_D         U_MS_R       U_WH_R      ,
//├─────────────┼─────────────┼─────────────┼─────────────┼─────────────┤                             ├─────────────┼─────────────┼─────────────┼─────────────┼─────────────┤
    ___           ___           ___           ___           ___         ,                               ___           &mkp LCLK     &mkp MCLK      &mkp RCLK    ___         ,
//╰─────────────┴─────────────┴─────────────┴─────────────┼─────────────┤─────────────╮ ╭─────────────┼─────────────┼─────────────┴─────────────┴───────────────────────────╯
                                                            ___           ___         ,   U_WH_U        U_WH_D
//                                                        ╰─────────────┴─────────────╯ ╰─────────────┴─────────────╯
)

/* vim: set ft=c tw=146: */
